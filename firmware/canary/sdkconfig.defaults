## firmware/canary/sdkconfig.defaults
```kconfig
# ═══════════════════════════════════════════════════════════════
# SecuraCV Canary — ESP-IDF sdkconfig overrides
# Trim unused components to reduce compile time and binary size
# ═══════════════════════════════════════════════════════════════

# ── Disable Bluetooth (HUGE compile time savings) ─────────────
# Re-enable in platformio.ini for builds that need it
CONFIG_BT_ENABLED=n
CONFIG_BLUEDROID_ENABLED=n
CONFIG_BLE_MESH=n

# ── Disable unused network protocols ──────────────────────────
CONFIG_LWIP_PPP_SUPPORT=n
CONFIG_LWIP_SNTP_MAX_SERVERS=1
CONFIG_ESP_WIFI_SOFTAP_SAE_SUPPORT=n
CONFIG_ESP_WIFI_ENTERPRISE_SUPPORT=n
CONFIG_WIFI_PROV_SCAN_MAX_ENTRIES=0

# ── Compiler: fastest compile for dev ─────────────────────────
# (overridden per-environment in platformio.ini)
CONFIG_COMPILER_OPTIMIZATION_DEBUG=y
CONFIG_COMPILER_OPTIMIZATION_ASSERTIONS_ENABLE=y

# ── Disable LTO for dev (dramatically faster link) ────────────
# Re-enable for release builds if needed
# CONFIG_LTO_ENABLED is not set

# ── Stack/heap reasonable defaults ────────────────────────────
CONFIG_ESP_MAIN_TASK_STACK_SIZE=8192
CONFIG_ESP_SYSTEM_EVENT_TASK_STACK_SIZE=4096

# ── Camera: keep PSRAM enabled ────────────────────────────────
CONFIG_SPIRAM=y
CONFIG_SPIRAM_MODE_OCT=y
CONFIG_SPIRAM_SPEED_80M=y

# ── mDNS: keep enabled (canary.local) ─────────────────────────
CONFIG_MDNS_MAX_SERVICES=4

# ── Partition table: use custom OTA partitions ─────────────────
CONFIG_PARTITION_TABLE_CUSTOM=y
CONFIG_PARTITION_TABLE_CUSTOM_FILENAME="partitions_ota.csv"

# ── HTTP server stack for streaming ───────────────────────────
CONFIG_HTTPD_MAX_REQ_HDR_LEN=1024
CONFIG_HTTPD_MAX_URI_LEN=512
```

## firmware/projects/canary-ota/sdkconfig.defaults
```kconfig
# SecuraCV Canary OTA - Default SDK Configuration
# This file sets default values for ESP-IDF sdkconfig options.
# These can be overridden in sdkconfig or via menuconfig.

# ============================================================================
# Partition Table
# ============================================================================

# Use custom partition table for OTA dual-partition scheme
CONFIG_PARTITION_TABLE_CUSTOM=y
CONFIG_PARTITION_TABLE_CUSTOM_FILENAME="partitions.csv"
CONFIG_PARTITION_TABLE_OFFSET=0x8000

# ============================================================================
# Bootloader
# ============================================================================

# Enable app rollback support (required for OTA validation)
CONFIG_BOOTLOADER_APP_ROLLBACK_ENABLE=y

# Log level for bootloader
CONFIG_BOOTLOADER_LOG_LEVEL_INFO=y

# ============================================================================
# Serial Flasher
# ============================================================================

# Flash size: 8MB (XIAO ESP32-S3)
CONFIG_ESPTOOLPY_FLASHSIZE_8MB=y
CONFIG_ESPTOOLPY_FLASHSIZE="8MB"

# Flash mode: QIO for best performance
CONFIG_ESPTOOLPY_FLASHMODE_QIO=y

# ============================================================================
# ESP System Settings
# ============================================================================

# CPU frequency
CONFIG_ESP_DEFAULT_CPU_FREQ_MHZ_240=y
CONFIG_ESP_DEFAULT_CPU_FREQ_MHZ=240

# ============================================================================
# PSRAM Configuration (XIAO ESP32-S3 has 8MB PSRAM)
# ============================================================================

CONFIG_SPIRAM=y
CONFIG_SPIRAM_MODE_OCT=y
CONFIG_SPIRAM_SPEED_80M=y
CONFIG_SPIRAM_BOOT_INIT=y
CONFIG_SPIRAM_USE_MALLOC=y
CONFIG_SPIRAM_MALLOC_ALWAYSINTERNAL=16384

# ============================================================================
# WiFi Configuration
# ============================================================================

# Placeholder WiFi credentials - CHANGE THESE for your network!
# Or use: pio run -t menuconfig -> Example Configuration
CONFIG_ESP_WIFI_SSID="YOUR_WIFI_SSID"
CONFIG_ESP_WIFI_PASSWORD="YOUR_WIFI_PASSWORD"

# WiFi settings
CONFIG_ESP_WIFI_AUTH_WPA2_PSK=y

# WiFi buffer settings
CONFIG_ESP_WIFI_STATIC_RX_BUFFER_NUM=10
CONFIG_ESP_WIFI_DYNAMIC_RX_BUFFER_NUM=32
CONFIG_ESP_WIFI_TX_BUFFER_TYPE=1
CONFIG_ESP_WIFI_DYNAMIC_TX_BUFFER_NUM=32

# ============================================================================
# HTTP Client
# ============================================================================

# Enable HTTPS support
CONFIG_ESP_HTTP_CLIENT_ENABLE_HTTPS=y

# ============================================================================
# TLS/SSL (mbedTLS)
# ============================================================================

# Increase TLS buffer for large certificates
CONFIG_MBEDTLS_SSL_MAX_CONTENT_LEN=16384

# Enable certificate verification
CONFIG_MBEDTLS_CERTIFICATE_BUNDLE=y
CONFIG_MBEDTLS_CERTIFICATE_BUNDLE_DEFAULT_FULL=y

# ============================================================================
# Logging
# ============================================================================

# Default log level: INFO
CONFIG_LOG_DEFAULT_LEVEL_INFO=y
CONFIG_LOG_DEFAULT_LEVEL=3

# Maximum log level that can be set at runtime
CONFIG_LOG_MAXIMUM_LEVEL_VERBOSE=y
CONFIG_LOG_MAXIMUM_LEVEL=5

# Add color to log output
CONFIG_LOG_COLORS=y

# ============================================================================
# FreeRTOS
# ============================================================================

# Tick rate
CONFIG_FREERTOS_HZ=1000

# Timer task stack size (increased for OTA)
CONFIG_FREERTOS_TIMER_TASK_STACK_DEPTH=4096

# Enable FreeRTOS stats
CONFIG_FREERTOS_USE_TRACE_FACILITY=y
CONFIG_FREERTOS_GENERATE_RUN_TIME_STATS=y

# ============================================================================
# Heap Memory
# ============================================================================

# Enable heap poisoning for debugging
CONFIG_HEAP_POISONING_LIGHT=y

# ============================================================================
# OTA Configuration
# ============================================================================

# Verify OTA image on first boot
CONFIG_BOOTLOADER_APP_ROLLBACK_ENABLE=y

# ============================================================================
# Compiler Options
# ============================================================================

# Optimization level
CONFIG_COMPILER_OPTIMIZATION_SIZE=y

# Stack protection
CONFIG_COMPILER_STACK_CHECK_MODE_NORM=y
CONFIG_COMPILER_STACK_CHECK=y

# ============================================================================
# NVS
# ============================================================================

# Enable NVS encryption support (for Phase 3)
CONFIG_NVS_ENCRYPTION=y
```

## firmware/provisioning/securacv-provisioning/sdkconfig.defaults.secure
```kconfig
# ============================================================================
# SecuraCV Canary — Secure Build Configuration (sdkconfig.defaults.secure)
# ERRERlabs
#
# Apply these settings on top of your base sdkconfig for production builds.
# These can be merged via:
#   cp sdkconfig.defaults.secure sdkconfig.defaults
#   idf.py reconfigure
#
# Or for PlatformIO, add to platformio.ini:
#   build_flags =
#       -DCONFIG_SECURE_BOOT=1
#       ... (see notes below)
#
# WARNING: Once a device is flashed with these settings and eFuses are burned,
# the device is PERMANENTLY locked to this security configuration.
# ============================================================================

# ── Secure Boot v2 ─────────────────────────────────────────────────────────

# Enable Secure Boot v2 (RSA-3072 based)
CONFIG_SECURE_BOOT=y
CONFIG_SECURE_BOOT_V2_ENABLED=y

# Sign binaries during build (set path to your signing key)
CONFIG_SECURE_SIGNED_APPS_NO_SECURE_BOOT=
CONFIG_SECURE_SIGNED_ON_BOOT=y
CONFIG_SECURE_SIGNED_APPS=y
CONFIG_SECURE_SIGNED_ON_UPDATE=y
CONFIG_SECURE_SIGNED_APPS_RSA_SCHEME=y
CONFIG_SECURE_BOOT_BUILD_SIGNED_BINARIES=y

# IMPORTANT: Set this to your actual key path
# CONFIG_SECURE_BOOT_SIGNING_KEY="keys/secure_boot_signing_key_0.pem"

# ── Flash Encryption ───────────────────────────────────────────────────────

# Enable Flash Encryption
CONFIG_SECURE_FLASH_ENC_ENABLED=y

# RELEASE mode — this is permanent. Development mode allows re-flashing.
# For production Canary devices, use RELEASE.
# For development, change to CONFIG_SECURE_FLASH_ENCRYPTION_MODE_DEVELOPMENT=y
CONFIG_SECURE_FLASH_ENCRYPTION_MODE_RELEASE=y

# Encrypt all partitions marked as "encrypted" in partition table
CONFIG_SECURE_FLASH_CHECK_ENC_EN_IN_APP=y

# ── JTAG & Debug Interfaces ───────────────────────────────────────────────

# Disable JTAG in software (eFuse burn happens during provisioning)
CONFIG_SECURE_DISABLE_ROM_DL_MODE=
CONFIG_SECURE_ENABLE_SECURE_ROM_DL_MODE=y

# ── UART Download Mode ─────────────────────────────────────────────────────

# Switch to secure UART download mode (not fully disabled, allows recovery)
# For maximum security, use CONFIG_SECURE_DISABLE_ROM_DL_MODE=y instead
CONFIG_SECURE_ENABLE_SECURE_ROM_DL_MODE=y

# ── Bluetooth — DISABLED ───────────────────────────────────────────────────

# The safest Bluetooth stack is the one that doesn't exist.
# Disabling BT removes all proprietary binary blobs from the firmware,
# eliminates the entire HCI attack surface (CVE-2025-27840 class),
# and reduces firmware size.
CONFIG_BT_ENABLED=
CONFIG_BT_NIMBLE_ENABLED=
CONFIG_BT_BLUEDROID_ENABLED=

# ── WiFi Configuration ─────────────────────────────────────────────────────

# WiFi remains enabled (needed for Canary AP mode)
CONFIG_ESP_WIFI_ENABLED=y

# Disable WiFi station mode scanning if not needed
# (Canary operates as AP only for local access)
# CONFIG_ESP_WIFI_STA_DISCONNECTED_PM_ENABLE=

# ── NVS Encryption ─────────────────────────────────────────────────────────

# Encrypt NVS partition (stores WiFi credentials, device config)
CONFIG_NVS_ENCRYPTION=y

# ── Anti-Rollback Protection ──────────────────────────────────────────────

# Prevent downgrade attacks via OTA
CONFIG_BOOTLOADER_APP_ANTI_ROLLBACK=y
CONFIG_BOOTLOADER_APP_SECURE_VERSION=1

# ── Bootloader Settings ───────────────────────────────────────────────────

# Reduce bootloader log verbosity in production
CONFIG_BOOTLOADER_LOG_LEVEL_WARN=y
CONFIG_BOOTLOADER_LOG_LEVEL=2

# Watchdog timer during boot
CONFIG_BOOTLOADER_WDT_ENABLE=y
CONFIG_BOOTLOADER_WDT_TIME_MS=9000

# ── Application Security ──────────────────────────────────────────────────

# Stack canary for buffer overflow detection
CONFIG_COMPILER_STACK_CHECK_MODE_STRONG=y
CONFIG_COMPILER_STACK_CHECK=y

# Brownout detector (prevents unstable voltage attacks)
CONFIG_ESP_BROWNOUT_DET=y
CONFIG_ESP_BROWNOUT_DET_LVL_SEL_7=y

# ── Partition Table ────────────────────────────────────────────────────────

# Use custom encrypted partition table
# CONFIG_PARTITION_TABLE_CUSTOM=y
# CONFIG_PARTITION_TABLE_CUSTOM_FILENAME="partitions_encrypted.csv"

# ── OTA Configuration ─────────────────────────────────────────────────────

# OTA updates must be signed with the same key
CONFIG_OTA_ALLOW_HTTP=
# CONFIG_ESP_HTTPS_OTA_ALLOW_HTTP=  # Force HTTPS for OTA
```
